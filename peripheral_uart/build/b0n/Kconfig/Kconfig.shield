## peripheral_uart/build/b0n/Kconfig/arch/Kconfig
```kconfig
# Load Zephyr Arch Kconfig descriptions.
osource "/home/khanh/ncs/v3.1.1/zephyr/arch/rx/Kconfig"
osource "/home/khanh/ncs/v3.1.1/zephyr/arch/x86/Kconfig"
osource "/home/khanh/ncs/v3.1.1/zephyr/arch/xtensa/Kconfig"
osource "/home/khanh/ncs/v3.1.1/zephyr/arch/sparc/Kconfig"
osource "/home/khanh/ncs/v3.1.1/zephyr/arch/riscv/Kconfig"
osource "/home/khanh/ncs/v3.1.1/zephyr/arch/posix/Kconfig"
osource "/home/khanh/ncs/v3.1.1/zephyr/arch/mips/Kconfig"
osource "/home/khanh/ncs/v3.1.1/zephyr/arch/arm64/Kconfig"
osource "/home/khanh/ncs/v3.1.1/zephyr/arch/arm/Kconfig"
osource "/home/khanh/ncs/v3.1.1/zephyr/arch/arc/Kconfig"
```

## peripheral_uart/build/ipc_radio/Kconfig/boards/Kconfig.defconfig
```kconfig
# Load Zephyr board defconfig descriptions.
osource "/home/khanh/ncs/v3.1.1/zephyr/boards/nordic/thingy53/Kconfig.defconfig"
```

## peripheral_uart/build/mcuboot/Kconfig/boards/Kconfig
```kconfig
# Load Zephyr board Kconfig descriptions.
osource "/home/khanh/ncs/v3.1.1/zephyr/boards/nordic/thingy53/Kconfig"
```
